## config/west.yml
```yaml
manifest:
  remotes:
    - name: zmkfirmware
      url-base: https://github.com/zmkfirmware
    - name: petejohanson
      url-base: https://github.com/petejohanson
    - name: AlexandrPK
      url-base: https://github.com/AlexandrPK
  projects:
    - name: zmk
      remote: zmkfirmware
      revision: main
      import: app/west.yml
      name: AlexandrPK
      remote: AlexandrPK
      revision: feat/pointers-move-scroll
  self:
    path: config
```
